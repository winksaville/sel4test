## apps/bootinfo/Kconfig
```kconfig
#
# Copyright 2015, Wink Saville
#
# This software may be distributed and modified according to the terms of
# the BSD 2-Clause license. Note that NO WARRANTY is provided.
# See "LICENSE_BSD2.txt" for details.

menuconfig APP_BOOTINFO
    bool "bootinfo"
    default n
    select LIB_SEL4
    select LIB_SEL4_PRINTF
    select LIB_SEL4_PUTCHAR
    select LIB_SEL4_STARTSTOP
    help
        Bootinfo
```

## apps/hi/Kconfig
```kconfig
#
# Copyright 2015, Wink Saville
#
# This software may be distributed and modified according to the terms of
# the BSD 2-Clause license. Note that NO WARRANTY is provided.
# See "LICENSE_BSD2.txt" for details.

menuconfig APP_HI
    bool "hi"
    default n
    select LIB_SEL4
    select LIB_SEL4_STARTSTOP
    select LIB_SEL4_PUTCHAR
    help
        An application that uses seL4_PutChar to print "hi\n".
```

## apps/min-app/Kconfig
```kconfig
#
# Copyright 2015, Wink Saville
#
# This software may be distributed and modified according to the terms of
# the BSD 2-Clause license. Note that NO WARRANTY is provided.
# See "LICENSE_BSD2.txt" for details.

menuconfig APP_MIN_APP
    bool "min-app"
    default n
    select LIB_SEL4
    select LIB_SEL4_STARTSTOP
    help
        Minimal application that just returns 0 from main.
```
